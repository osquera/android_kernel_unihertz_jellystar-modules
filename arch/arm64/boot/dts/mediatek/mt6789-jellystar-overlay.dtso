// SPDX-License-Identifier: GPL-2.0
/*
 * Unihertz Jelly Star (MT6789) board overlay, applied by the bootloader on top of mt6789.dtb.
 *
 * The board description (pins, GPIOs, regulators, panel, sensors, charger, LEDs, ...) is the
 * one the stock firmware ships (V01.00.04 DTBO and the additions in its base DTB), turned into
 * source with phandles written as labels of MediaTek's mt6789.dts. Applied to mt6789.dtb it
 * gives the stock device tree, except for properties where this tree's MediaTek release
 * differs; the video encoder node keeps the stock values (see below).
 */
/dts-v1/;
/plugin/;

/* Jelly Star additions to MediaTek's mt6789.dts (stock base DTB) */
&{/mtk_lpm/irq-remain-list} {
	level_disp_aal0: level-disp-aal0 {
		target = <&disp_aal0>;
		value = <0x0 0x0 0x0 0x0>;
	};
};

&{/soc} {
	frsm_amp: frsm_amp {
		compatible = "foursemi,frsm-amp";
		frsm,amp-ndev = <0x1>;
		frsm,misc-enable;
		frsm,class-enable;
		status = "okay";
	};
	tkcore: tkcore {
		compatible = "trustkernel,tzdrv";
	};
};

&i2c5 {
	rt1711h@4e {
		compatible = "richtek,rt1711h";
		reg = <0x4e>;
		status = "okay";
		rt-tcpc,name = "type_c_port0";
		rt-tcpc,role-def = <0x5>;
		rt-tcpc,rp-level = <0x0>;
		rt-tcpc,vconn-supply = <0x1>;
		rt1711pd,intr-gpio = <&pio 0x29 0x0>;
		rt1711pd,intr-gpio-num = <0x29>;

		displayport {
			1st-connection = "dfp-d";
			2nd-connection = "dfp-d";
			typec,receptacle;

			dfp-d {
				pin-assignment,mode-c;
				pin-assignment,mode-d;
				pin-assignment,mode-e;
			};

			ufp-d {
			};
		};

		dpm-caps {
			local-dr-power;
			local-dr-data;
			local-usb-comm;
			local-no-suspend;
			pr-check = <0x0>;
			dr-check = <0x0>;
		};

		pd-data {
			pd,vid = <0x29cf>;
			pd,pid = <0x1711>;
			pd,source-cap-ext = [cf 29 11 17 00 00 00 00 00 00 00 00 00 00 00 00 00 00 00 00 00 00 01 02 00];
			pd,sink-cap-ext = <0xcf291117 0x0 0x100 0x0 0x12b010a 0xa000000>;
			pd,mfrs = "RichtekTCPC";
			pd,charging-policy = <0x31>;
			pd,source-pdo-size = <0x1>;
			pd,source-pdo-data = <0x19032>;
			pd,sink-pdo-size = <0x1>;
			pd,sink-pdo-data = <0x190c8>;
			pd,id-vdo-size = <0x6>;
			pd,id-vdo-data = <0xd14029cf 0x0 0x17110000 0x61000000 0x0 0x41000000>;
			bat,nr = <0x1>;

			bat-info0 {
				bat,vid = <0x29cf>;
				bat,pid = <0x1711>;
				bat,mfrs = "bat1";
				bat,design-cap = <0x1e>;
			};
		};
	};
	rt1718s_typec: rt1718s@40 {
		compatible = "richtek,rt1718s";
		reg = <0x40>;
		wakeup-source;
		status = "okay";
		tcpc,name = "type_c_port0";
		tcpc,role-def = <0x5>;
		tcpc,rp-level = <0x0>;
		tcpc,vconn-supply = <0x1>;
		interrupts-extended = <&pio 0x2a 0x8>;
		tcpc,en-ctd;

		displayport {
			1st-connection = "dfp-d";
			2nd-connection = "dfp-d";
			typec,receptacle;

			dfp-d {
				pin-assignment,mode-c;
				pin-assignment,mode-d;
				pin-assignment,mode-e;
			};

			ufp-d {
			};
		};

		dpm-caps {
			local-dr-power;
			local-dr-data;
			local-usb-comm;
			local-no-suspend;
			pr-check = <0x0>;
			dr-check = <0x0>;
		};

		pd-data {
			pd,vid = <0x29cf>;
			pd,pid = <0x1718>;
			pd,source-cap-ext = [cf 29 18 17 00 00 00 00 00 00 00 00 00 00 00 00 00 00 00 00 00 00 01 02 00];
			pd,sink-cap-ext = <0xcf291817 0x0 0x100 0x0 0x12b010a 0xa000000>;
			pd,mfrs = "RichtekTCPC";
			pd,charging-policy = <0x31>;
			pd,source-pdo-size = <0x1>;
			pd,source-pdo-data = <0x19032>;
			pd,sink-pdo-size = <0x1>;
			pd,sink-pdo-data = <0x190c8>;
			pd,id-vdo-size = <0x6>;
			pd,id-vdo-data = <0xd14029cf 0x0 0x17180000 0x61000000 0x0 0x41000000>;
			bat,nr = <0x1>;

			bat-info0 {
				bat,vid = <0x29cf>;
				bat,pid = <0x1718>;
				bat,mfrs = "bat1";
				bat,design-cap = <0x1e>;
			};
		};
	};
	rt9471@53 {
		compatible = "richtek,rt9471";
		reg = <0x53>;
		ceb-gpios = <&pio 0x3 0x0>;
		wakeup-source;
		interrupts-extended = <&pio 0x4 0x2>;
		interrupt-controller;
		#interrupt-cells = <0x1>;
		chg_name = "primary_chg";
		chg_alias_name = "rt9471_chg";
		phys = <&u2port0 0x3>;
		phy-names = "usb2-phy";
		usb = <&usb>;

		rt9471_otg_vbus: otg-vbus {
			regulator-compatible = "otg-vbus";
			regulator-min-microvolt = <0x4a0150>;
			regulator-max-microvolt = <0x50df20>;
			regulator-min-microamp = <0x7a120>;
			regulator-max-microamp = <0x124f80>;
		};
	};
};


&mtk_gauge {
	io-channels = <&pmic_auxadc 0x3 &pmic_auxadc 0x0 &pmic_auxadc 0xe &pmic_auxadc 0xf &pmic_auxadc 0x10 &pmic_auxadc 0x2>;
	io-channel-names = "pmic_battery_temp", "pmic_battery_voltage", "pmic_bif_voltage", "pmic_ptim_voltage", "pmic_ptim_r", "pmic_vbus";
};

&mtk_lpm {
	irq-remain = <&edge_keypad &edge_mdwdt &level_btif_tx &level_btif_rx &level_usb &level_disp_aal0>;
};

&mt6366keys {
	/* MediaTek's second key is "home" with KEY_VOLUMEUP; on the Jelly Star it is the
	 * programmable side key, keycode 250 (as stock) */
	home {
		linux,keycodes = <0xfa>;
		wakeup-source;
	};
};

&{/soc/venc@17000000} {
	/* stock's values; our encoder driver (from OnePlus' mt6993 tree) works with these */
	venc-core-count = <0x1>;
	port-def = <0x0 0x100e0 0x0 0x0 0x100e1 0x0 0x0 0x100e2 0x0 0x0 0x100e3 0x0 0x0 0x100e4 0x0 0x0 0x100e5 0x0 0x0 0x100e6 0x0 0x0 0x100e7 0x0 0x0 0x100e8 0x0 0x0 0x100e9 0x0 0x0 0x100ea 0x0 0x0 0x100eb 0x0 0x0 0x100ec 0x0>;
	throughput-table = <0x34363248 0x1 0x47c 0x47c 0xed77040 0x64 0x34363248 0x4 0x35c 0x35c 0xed77040 0x64 0x34363248 0x8 0x30c 0x30c 0xed77040 0x64 0x34363248 0xc 0x35c 0x35c 0xed77040 0x64 0x34363248 0x11 0x1ae 0x1ae 0xed77040 0x64 0x43564548 0x1 0x47c 0x47c 0xed77040 0x64 0x43564548 0x4 0x35c 0x35c 0xed77040 0x64 0x43564548 0x8 0x30c 0x30c 0xed77040 0x64 0x43564548 0xc 0x35c 0x35c 0xed77040 0x64 0x43564548 0x11 0x1ae 0x1ae 0xed77040 0x64 0x35363248 0x1 0x47c 0x47c 0xed77040 0x64 0x35363248 0x4 0x35c 0x35c 0xed77040 0x64 0x35363248 0x8 0x30c 0x30c 0xed77040 0x64 0x43564548 0xc 0x35c 0x35c 0xed77040 0x64 0x35363248 0x11 0x1ae 0x1ae 0xed77040 0x64 0x46494548 0x1 0x47c 0x47c 0xed77040 0x64 0x46494548 0x4 0x35c 0x35c 0xed77040 0x64 0x46494548 0x8 0x30c 0x30c 0xed77040 0x64 0x43564548 0xc 0x35c 0x35c 0xed77040 0x64 0x46494548 0x11 0x1ae 0x1ae 0xed77040 0x64>;
};

&pio {

	camera_pins_cam0_rst_0: cam0@0 {

		pins_cmd_dat {
			pinmux = <0x1400>;
			slew-rate = <0x1>;
			output-low;
		};
	};

	camera_pins_cam0_rst_1: cam0@1 {

		pins_cmd_dat {
			pinmux = <0x1400>;
			slew-rate = <0x1>;
			output-high;
		};
	};

	camera_pins_cam1_rst_0: cam1@0 {

		pins_cmd_dat {
			pinmux = <0x1000>;
			slew-rate = <0x1>;
			output-low;
		};
	};

	camera_pins_cam1_rst_1: cam1@1 {

		pins_cmd_dat {
			pinmux = <0x1000>;
			slew-rate = <0x1>;
			output-high;
		};
	};

	camera_pins_cam0_pnd_0: cam0@2 {

		pins_cmd_dat {
			pinmux = <0x1300>;
			slew-rate = <0x1>;
			output-low;
		};
	};

	camera_pins_cam0_pnd_1: cam0@3 {

		pins_cmd_dat {
			pinmux = <0x1300>;
			slew-rate = <0x1>;
			output-high;
		};
	};

	camera_pins_cam1_pnd_0: cam1@2 {

		pins_cmd_dat {
			pinmux = <0xf00>;
			slew-rate = <0x1>;
			output-low;
		};
	};

	camera_pins_cam1_pnd_1: cam1@3 {

		pins_cmd_dat {
			pinmux = <0xf00>;
			slew-rate = <0x1>;
			output-high;
		};
	};

	camera_pins_cam0_ldo_vcama_0: cam0@vcam0 {

		pins_cmd_dat {
			pinmux = <0x2200>;
			slew-rate = <0x1>;
			output-low;
		};
	};

	camera_pins_cam0_ldo_vcama_1: cam0@vcam1 {

		pins_cmd_dat {
			pinmux = <0x2200>;
			slew-rate = <0x1>;
			output-high;
		};
	};

	camera_pins_cam1_ldo_vcama_0: cam1@vcam0 {

		pins_cmd_dat {
			pinmux = <0x2400>;
			slew-rate = <0x1>;
			output-low;
		};
	};

	camera_pins_cam1_ldo_vcama_1: cam1@vcam1 {

		pins_cmd_dat {
			pinmux = <0x2400>;
			slew-rate = <0x1>;
			output-high;
		};
	};

	camera_pins_cam0_ldo_vcama1_0: cam0@vcam2 {

		pins_cmd_dat {
			pinmux = <0x1200>;
			slew-rate = <0x1>;
			output-low;
		};
	};

	camera_pins_cam0_ldo_vcama1_1: cam0@vcam3 {

		pins_cmd_dat {
			pinmux = <0x1200>;
			slew-rate = <0x1>;
			output-high;
		};
	};

	camera_pins_cam0_ldo_vcamd_0: cam0@vcam4 {

		pins_cmd_dat {
			pinmux = <0x2300>;
			slew-rate = <0x1>;
			output-low;
		};
	};

	camera_pins_cam0_ldo_vcamd_1: cam0@vcam5 {

		pins_cmd_dat {
			pinmux = <0x2300>;
			slew-rate = <0x1>;
			output-high;
		};
	};

	camera_pins_cam1_ldo_vcamd_0: cam1@vcam4 {

		pins_cmd_dat {
			pinmux = <0x2500>;
			slew-rate = <0x1>;
			output-low;
		};
	};

	camera_pins_cam1_ldo_vcamd_1: cam1@vcam5 {

		pins_cmd_dat {
			pinmux = <0x2500>;
			slew-rate = <0x1>;
			output-high;
		};
	};

	camera_pins_cam0_ldo_vcamio_0: cam0@vcam6 {

		pins_cmd_dat {
			pinmux = <0x1200>;
			slew-rate = <0x1>;
			output-low;
		};
	};

	camera_pins_cam0_ldo_vcamio_1: cam0@vcam7 {

		pins_cmd_dat {
			pinmux = <0x1200>;
			slew-rate = <0x1>;
			output-high;
		};
	};

	camera_pins_cam1_ldo_vcamio_0: cam1@vcam6 {

		pins_cmd_dat {
			pinmux = <0x1200>;
			slew-rate = <0x1>;
			output-low;
		};
	};

	camera_pins_cam1_ldo_vcamio_1: cam1@vcam7 {

		pins_cmd_dat {
			pinmux = <0x1200>;
			slew-rate = <0x1>;
			output-high;
		};
	};

	camera_pins_cam0_mclk_off: camera_pins_cam0_mclk_off {

		pins_cmd_dat {
			pinmux = <0x8000>;
			drive-strength = <0x1>;
		};
	};

	camera_pins_cam0_mclk_2ma: camera_pins_cam0_mclk_2ma {

		pins_cmd_dat {
			pinmux = <0x8001>;
			drive-strength = <0x0>;
		};
	};

	camera_pins_cam0_mclk_4ma: camera_pins_cam0_mclk_4ma {

		pins_cmd_dat {
			pinmux = <0x8001>;
			drive-strength = <0x1>;
		};
	};

	camera_pins_cam0_mclk_6ma: camera_pins_cam0_mclk_6ma {

		pins_cmd_dat {
			pinmux = <0x8001>;
			drive-strength = <0x2>;
		};
	};

	camera_pins_cam0_mclk_8ma: camera_pins_cam0_mclk_8ma {

		pins_cmd_dat {
			pinmux = <0x8001>;
			drive-strength = <0x3>;
		};
	};

	camera_pins_cam1_mclk_off: camera_pins_cam1_mclk_off {

		pins_cmd_dat {
			pinmux = <0x7e00>;
			drive-strength = <0x1>;
		};
	};

	camera_pins_cam1_mclk_2ma: camera_pins_cam1_mclk_2ma {

		pins_cmd_dat {
			pinmux = <0x7e01>;
			drive-strength = <0x0>;
		};
	};

	camera_pins_cam1_mclk_4ma: camera_pins_cam1_mclk_4ma {

		pins_cmd_dat {
			pinmux = <0x7e01>;
			drive-strength = <0x1>;
		};
	};

	camera_pins_cam1_mclk_6ma: camera_pins_cam1_mclk_6ma {

		pins_cmd_dat {
			pinmux = <0x7e01>;
			drive-strength = <0x2>;
		};
	};

	camera_pins_cam1_mclk_8ma: camera_pins_cam1_mclk_8ma {

		pins_cmd_dat {
			pinmux = <0x7e01>;
			drive-strength = <0x3>;
		};
	};

	camera_pins_default: camera_pins_default {
	};
};

&kd_camera_hw1 {
	pinctrl-names = "default", "cam0_rst0", "cam0_rst1", "cam1_rst0", "cam1_rst1", "cam0_pnd0", "cam0_pnd1", "cam0_ldo_vcama_0", "cam0_ldo_vcama_1", "cam1_ldo_vcama_0", "cam1_ldo_vcama_1", "cam0_ldo_vcama1_0", "cam0_ldo_vcama1_1", "cam0_ldo_vcamd_0", "cam0_ldo_vcamd_1", "cam1_ldo_vcamd_0", "cam1_ldo_vcamd_1", "cam0_ldo_vcamio_0", "cam0_ldo_vcamio_1", "cam1_ldo_vcamio_0", "cam1_ldo_vcamio_1", "cam0_mclk_off", "cam0_mclk_2mA", "cam0_mclk_4mA", "cam0_mclk_6mA", "cam0_mclk_8mA", "cam1_mclk_off", "cam1_mclk_2mA", "cam1_mclk_4mA", "cam1_mclk_6mA", "cam1_mclk_8mA";
	pinctrl-0 = <&camera_pins_default>;
	pinctrl-1 = <&camera_pins_cam0_rst_0>;
	pinctrl-2 = <&camera_pins_cam0_rst_1>;
	pinctrl-3 = <&camera_pins_cam1_rst_0>;
	pinctrl-4 = <&camera_pins_cam1_rst_1>;
	pinctrl-5 = <&camera_pins_cam0_pnd_0>;
	pinctrl-6 = <&camera_pins_cam0_pnd_1>;
	pinctrl-7 = <&camera_pins_cam0_ldo_vcama_0>;
	pinctrl-8 = <&camera_pins_cam0_ldo_vcama_1>;
	pinctrl-9 = <&camera_pins_cam1_ldo_vcama_0>;
	pinctrl-10 = <&camera_pins_cam1_ldo_vcama_1>;
	pinctrl-11 = <&camera_pins_cam0_ldo_vcama1_0>;
	pinctrl-12 = <&camera_pins_cam0_ldo_vcama1_1>;
	pinctrl-13 = <&camera_pins_cam0_ldo_vcamd_0>;
	pinctrl-14 = <&camera_pins_cam0_ldo_vcamd_1>;
	pinctrl-15 = <&camera_pins_cam1_ldo_vcamd_0>;
	pinctrl-16 = <&camera_pins_cam1_ldo_vcamd_1>;
	pinctrl-17 = <&camera_pins_cam0_ldo_vcamio_0>;
	pinctrl-18 = <&camera_pins_cam0_ldo_vcamio_1>;
	pinctrl-19 = <&camera_pins_cam1_ldo_vcamio_0>;
	pinctrl-20 = <&camera_pins_cam1_ldo_vcamio_1>;
	pinctrl-21 = <&camera_pins_cam0_mclk_off>;
	pinctrl-22 = <&camera_pins_cam0_mclk_2ma>;
	pinctrl-23 = <&camera_pins_cam0_mclk_4ma>;
	pinctrl-24 = <&camera_pins_cam0_mclk_6ma>;
	pinctrl-25 = <&camera_pins_cam0_mclk_8ma>;
	pinctrl-26 = <&camera_pins_cam1_mclk_off>;
	pinctrl-27 = <&camera_pins_cam1_mclk_2ma>;
	pinctrl-28 = <&camera_pins_cam1_mclk_4ma>;
	pinctrl-29 = <&camera_pins_cam1_mclk_6ma>;
	pinctrl-30 = <&camera_pins_cam1_mclk_8ma>;
	cam0_pin_mclk = "mclk";
	cam0_pin_rst = "gpio";
	cam0_pin_pdn = "gpio";
	cam0_pin_vcama = "gpio";
	cam0_pin_vcamio = "gpio";
	cam0_pin_vcamd = "gpio";
	cam0_pin_vcama1 = "gpio";
	cam0_pin_vcamaf = "gpio";
	cam1_pin_mclk = "mclk";
	cam1_pin_rst = "gpio";
	cam1_pin_pdn = "gpio";
	cam1_pin_vcama = "gpio";
	cam1_pin_vcamio = "gpio";
	cam1_pin_vcamd = "gpio";
	cam1_pin_vcama1 = "gpio";
	cam1_pin_vcamaf = "gpio";
	cam0_enable_sensor = "s5kgm2_mipi_raw s5kgm2gms_mipi_raw";
	cam1_enable_sensor = "imx219_mipi_raw imx219gms_mipi_raw";
	status = "okay";
};

&i2c4 {
	status = "okay";
	clock-frequency = <0x61a80>;
	#address-cells = <0x1>;
	#size-cells = <0x0>;

	mtk_camera_eeprom1: camera-eeprom1@51 {
		compatible = "mediatek,camera_eeprom";
		reg = <0x51>;
		status = "okay";
	};

	camera_sub_mtk: camera_sub_mtk@1a {
		compatible = "mediatek,camera_sub";
		#thermal-sensor-cells = <0x0>;
		reg = <0x1a>;
		status = "okay";
	};
};

&i2c8 {
	status = "okay";
	clock-frequency = <0x61a80>;
	#address-cells = <0x1>;
	#size-cells = <0x0>;

	mtk_camera_eeprom0: camera-eeprom0@50 {
		compatible = "mediatek,camera_eeprom";
		reg = <0x50>;
		status = "okay";
	};

	camera_main_mtk: camera_main@1a {
		compatible = "mediatek,camera_main";
		#thermal-sensor-cells = <0x0>;
		reg = <0x1a>;
		status = "okay";
	};
};

&thermal_zones {

	camera_main: camera_main {
		polling-delay = <0x3e8>;
		polling-delay-passive = <0x0>;
		thermal-sensors = <&camera_main_mtk>;
	};

	camera_sub: camera_sub {
		polling-delay = <0x3e8>;
		polling-delay-passive = <0x0>;
		thermal-sensors = <&camera_sub_mtk>;
	};
};

&reserved_memory {

	tkcore {
		compatible = "trustkernel,shared_mem";
		no-map;
		size = <0x0 0x1000000>;
		alignment = <0x0 0x1000>;
		alloc-ranges = <0x0 0x40000000 0x0 0x80000000>;
	};
};

&{/} {

	agold_gms_board {
		compatible = "agold,agold_gms_board";
		agold_board_check = <0x1>;
		agold_board_adc = <0x514 0x5dc>;
		gms_id_channel = <0x6>;
		io-channels = <&auxadc 0x6>;
		io-channel-names = "agold_board_id";
		status = "okay";
	};

	agold_auxadc4: agold_auxadc4 {
		compatible = "agold,auxadc4";
		io-channels = <&auxadc 0x4>;
		io-channel-names = "g_channel4";
	};

	agold_auxadc5: agold_auxadc5 {
		compatible = "agold,auxadc5";
		io-channels = <&auxadc 0x5>;
		io-channel-names = "g_channel5";
	};

	touch_pad: touch_pad {
		compatible = "mediatek,touch_pad";
	};

	lampbelt_leds: lampbelt_leds {
		compatible = "agold,lampbelt_leds";
		lampbelt_leds,gpio_pwr = <&pio 0x6a 0x0 &pio 0x78 0x0>;
		lampbelt_leds,nums = <0x2>;
		lampbelt_leds,gpio_en = <&pio 0x6b 0x0 &pio 0x68 0x0>;
		lampbelt_leds,pwm_ch = <0x2>;
		lampbelt_leds,remain1 = <0x0>;
		lampbelt_leds,adc_white = <0x0 0x1f4>;
		lampbelt_leds,adc_color = <0x258 0x4b0>;
		io-channels = <&auxadc 0x6>;
		io-channel-names = "lampbelt_id";
		lampbelt_leds,white_color = <0xff 0xff 0xff>;
		status = "okay";
	};
};

&chosen {
};

&mtk_leds {
	compatible = "mediatek,pwm-leds";

	backlight {
		pwms = <&disp_pwm 0x0 0x99d9>;
		led-mode = <0x5>;
		gate-enable = <0x0>;
		pwm-config = <0x0 0x1 0x0 0x0 0x0>;
	};
};

&gate_ic {
	pwm-enable = <0x1>;
};

&pio {

	mtkfb_pins_lcm_led_en1: lcm_led_en1_gpio {

		pins_cmd_dat {
			pinmux = <0x9900>;
			slew-rate = <0x1>;
			output-high;
		};
	};

	mtkfb_pins_lcm_led_en0: lcm_led_en0_gpio {

		pins_cmd_dat {
			pinmux = <0x9900>;
			slew-rate = <0x1>;
			output-low;
		};
	};

	mtkfb_pins_lcd_bias_enp1: lcd_bias_enp1_gpio {

		pins_cmd_dat {
			pinmux = <0x1a00>;
			slew-rate = <0x1>;
			output-high;
		};
	};

	mtkfb_pins_lcd_bias_enp0: lcd_bias_enp0_gpio {

		pins_cmd_dat {
			pinmux = <0x1a00>;
			slew-rate = <0x1>;
			output-low;
		};
	};

	mtkfb_pins_lcd_bias_enn1: lcd_bias_enn1_gpio {

		pins_cmd_dat {
			pinmux = <0x1b00>;
			slew-rate = <0x1>;
			output-high;
		};
	};

	mtkfb_pins_lcd_bias_enn0: lcd_bias_enn0_gpio {

		pins_cmd_dat {
			pinmux = <0x1b00>;
			slew-rate = <0x1>;
			output-low;
		};
	};

	mtkfb_pins_lcm_rst_out1_gpio: lcm_rst_out1_gpio {

		pins_cmd_dat {
			pinmux = <0x5500>;
			slew-rate = <0x1>;
			output-high;
		};
	};

	mtkfb_pins_lcm_rst_out0_gpio: lcm_rst_out0_gpio {

		pins_cmd_dat {
			pinmux = <0x5500>;
			slew-rate = <0x1>;
			output-low;
		};
	};

	mtkfb_pins_lcm_dsi_te: lcm_dsi_te {

		pins_cmd_dat {
			pinmux = <0x5301>;
		};
	};
};

&mtkfb {
	pinctrl-names = "lcm_led_en1_gpio", "lcm_led_en0_gpio", "lcd_bias_enp1_gpio", "lcd_bias_enp0_gpio", "lcd_bias_enn1_gpio", "lcd_bias_enn0_gpio", "lcm_rst_out1_gpio", "lcm_rst_out0_gpio", "mode_te_te";
	pinctrl-0 = <&mtkfb_pins_lcm_led_en1>;
	pinctrl-1 = <&mtkfb_pins_lcm_led_en0>;
	pinctrl-2 = <&mtkfb_pins_lcd_bias_enp1>;
	pinctrl-3 = <&mtkfb_pins_lcd_bias_enp0>;
	pinctrl-4 = <&mtkfb_pins_lcd_bias_enn1>;
	pinctrl-5 = <&mtkfb_pins_lcd_bias_enn0>;
	pinctrl-6 = <&mtkfb_pins_lcm_rst_out1_gpio>;
	pinctrl-7 = <&mtkfb_pins_lcm_rst_out0_gpio>;
	pinctrl-8 = <&mtkfb_pins_lcm_dsi_te>;
	status = "okay";
};

&dispsys_config {
	pinctrl-names = "lcm_rst_out1_gpio", "lcm_rst_out0_gpio", "mode_te_te";
	pinctrl-0 = <&mtkfb_pins_lcm_rst_out1_gpio>;
	pinctrl-1 = <&mtkfb_pins_lcm_rst_out0_gpio>;
	pinctrl-2 = <&mtkfb_pins_lcm_dsi_te>;
	status = "okay";
};

&dsi0 {
	status = "okay";
	#address-cells = <0x1>;
	#size-cells = <0x0>;

	panel1@0 {
		compatible = "zhunyi,st7701,vdo";
		reg = <0x0>;
		pm-enable-gpios = <&pio 0x97 0x0>;
		sensor-gpios = <&pio 0xa 0x0>;
		reset-gpios = <&pio 0x55 0x0>;
		bias-gpios = <&pio 0xc 0x0 &pio 0xd 0x0>;
		io_1_8-gpios = <&pio 0x2d 0x0>;
		io_2_8-gpios = <&pio 0x97 0x0>;
		gate-ic = <0x0>;
		pinctrl-names = "default";

		port {

			panel_in1: endpoint {
				remote-endpoint = <&dsi_out>;
			};
		};
	};

	panel2@0 {
		compatible = "truly,td4330,cmd";
		reg = <0x1>;
		pm-enable-gpios = <&pio 0xc 0x0>;
		reset-gpios = <&pio 0x55 0x0>;
		gate-ic = <0x12df>;
		pinctrl-names = "default";

		port {

			panel_in2: endpoint {
				remote-endpoint = <&dsi_out>;
			};
		};
	};

	ports {

		port {

			dsi_out: endpoint {
				remote-endpoint = <&panel_in1>;
			};
		};
	};
};

&pio {

	gps_pins_default: gps_default {
	};

	gps_l1_lna_pins_ol: gps_l1_lna@0 {

		pins_cmd_dat {
			pinmux = <0x1900>;
			output-low;
		};
	};

	gps_l1_lna_pins_dsp_ctrl: gps_l1_lna@1 {

		pins_cmd_dat {
			pinmux = <0x1902>;
		};
	};

	gps_l1_lna_pins_oh: gps_l1_lna@2 {

		pins_cmd_dat {
			pinmux = <0x1900>;
			output-high;
		};
	};

	gps_l5_lna_pins_ol: gps_l5_lna@0 {

		pins_cmd_dat {
			pinmux = <0x1a00>;
			output-low;
		};
	};

	gps_l5_lna_pins_dsp_ctrl: gps_l5_lna@1 {

		pins_cmd_dat {
			pinmux = <0x1a02>;
		};
	};

	gps_l5_lna_pins_oh: gps_l5_lna@2 {

		pins_cmd_dat {
			pinmux = <0x1a00>;
			output-high;
		};
	};
};

&gps {
	pinctrl-names = "default", "gps_l1_lna_disable", "gps_l1_lna_dsp_ctrl", "gps_l1_lna_enable", "gps_l5_lna_disable", "gps_l5_lna_dsp_ctrl", "gps_l5_lna_enable";
	pinctrl-0 = <&gps_pins_default>;
	pinctrl-1 = <&gps_l1_lna_pins_ol>;
	pinctrl-2 = <&gps_l1_lna_pins_dsp_ctrl>;
	pinctrl-3 = <&gps_l1_lna_pins_oh>;
	pinctrl-4 = <&gps_l5_lna_pins_ol>;
	pinctrl-5 = <&gps_l5_lna_pins_dsp_ctrl>;
	pinctrl-6 = <&gps_l5_lna_pins_oh>;
	status = "okay";
};

&i2c6 {

	lm3643: lm3643@63 {
		compatible = "mediatek,lm3643";
		reg = <0x63>;
		#cooling-cells = <0x2>;
		pinctrl-names = "default", "hwen-high", "hwen-low";
		pinctrl-0 = <&lm3643_pins_default>;
		pinctrl-1 = <&lm3643_pins_hwen_high>;
		pinctrl-2 = <&lm3643_pins_hwen_low>;
		status = "okay";

		flash@0 {
			reg = <0x0>;
			type = <0x0>;
			ct = <0x0>;
			part = <0x0>;

			port@0 {

				fl_core_0: endpoint {
					remote-endpoint = <&flashlight_0>;
				};
			};
		};

		flash@1 {
			reg = <0x1>;
			type = <0x0>;
			ct = <0x1>;
			part = <0x0>;

			port@1 {

				fl_core_1: endpoint {
					remote-endpoint = <&flashlight_1>;
				};
			};
		};
	};
};

&pio {

	lm3643_pins_default: default {
	};

	lm3643_pins_hwen_high: hwen-low {

		pins_cmd_dat {
			pinmux = <0x9d00>;
			slew-rate = <0x1>;
			output-high;
		};
	};

	lm3643_pins_hwen_low: hwen_low {

		pins_cmd_dat {
			pinmux = <0x9d00>;
			slew-rate = <0x1>;
			output-low;
		};
	};
};

&mtk_composite_v4l2_1 {

	port@0 {

		flashlight_0: endpoint {
			remote-endpoint = <&fl_core_0>;
		};
	};

	port@1 {

		flashlight_1: endpoint {
			remote-endpoint = <&fl_core_1>;
		};
	};
};

&i2c8 {

	camera_main_af_mtk: camera_main_af@72 {
		compatible = "mediatek,camera_main_af";
		reg = <0x72>;
		status = "okay";
	};
};

&i2c2 {

	camera_main_two_af_mtk: camera_main_two_af@0d {
		compatible = "mediatek,camera_main_two_af";
		reg = <0xd>;
		status = "okay";
	};

	camera_main_three_af_mtk: camera_main_three_af@0c {
		compatible = "mediatek,camera_main_three_af";
		reg = <0xc>;
		status = "okay";
	};
};

&camera_af_hw_node {
	camaf_m1_pmic-supply = <&rt5133_ldo3>;
	camaf_m2_pmic-supply = <&rt5133_gpio1>;
	camaf_m3_pmic-supply = <&rt5133_gpio1>;
	status = "okay";
};

&pdc {
	pd_vbus_upper_bound = <0x895440>;
};

&i2c6 {

	i2c_lcd_bias: i2c_lcd_bias@3e {
		compatible = "mediatek,i2c_lcd_bias";
		reg = <0x3e>;
		id = <0x6>;
		status = "okay";
	};
};

&i2c5 {

	rt1711_typec: rt1711h@4e {
		rt1711pd,intr-gpio = <&pio 0xd 0x0>;
		rt1711pd,intr-gpio_num = <0xd>;
		charger = <&rt9471_chg>;
	};
};

&extcon_usb {
	vbus-supply = <&rt9471_otg_vbus>;
	vbus-current = <0x124f80>;
	charger = <&rt9471_chg>;
};

&charger {
	charger = <&rt9471_chg>;
	bc12-psy = <&rt9471_chg>;
	battery-cv = <0x43e6d0>;
	charger-configuration = <0x0>;
};

&mtk_ctd {
	bc12-psy-port0 = <&rt9471_chg>;
};

&mt6375 {
	status = "disable";
};

&mtk_gauge {
	charger = <&rt9471_chg>;
};

&battery_manager {
	charger = <&rt9471_chg>;
};

&pe5 {
	vbat-cv = <0x1162>;
	ita-level = <0x9c4 0x898 0x7d0 0x5dc>;
	rcable-level-dual = <0x104 0x15e 0x1c2 0x226>;
};

&i2c5 {
	#address-cells = <0x1>;
	#size-cells = <0x0>;

	rt9471_chg: rt9471@53 {
		compatible = "richtek,rt9471";
		reg = <0x53>;
		ceb-gpios = <&pio 0x96 0x0>;
	};
};

&i2c3 {

	tms_nfc@28 {
		status = "okay";
		compatible = "tms,nfc";
		reg = <0x28>;
		tms,irq-gpio = <&pio 0x1 0x0>;
		tms,ven-gpio = <&pio 0x39 0x0>;
		tms,download-gpio = <&pio 0x15 0x0>;
		tms,device-name = "tms_nfc";
		tms,device-count = <0x1>;
	};
};

&i2c0 {
	clock-frequency = <0x61a80>;

	cap_touch: cap_touch@38 {
		compatible = "mediatek,cap_touch";
		reg = <0x2e>;
		status = "okay";
		interrupts = <0x9 0x2 0x9 0x0>;
		interrupt-parent = <&pio>;
		tpd-resolution = <0x1e0 0x356>;
		use-tpd-button = <0x1>;
		tpd-key-num = <0x3>;
		tpd-key-local = <0x9e 0xac 0x244 0x0>;
		tpd-key-dim-local = <0x3c 0x38b 0x28 0x28 0x12c 0x38b 0x28 0x28 0xb4 0x38b 0x28 0x28 0x0 0x0 0x0 0x0>;
		tpd-max-touch-num = <0xa>;
		tpd-filter-enable = <0x0>;
		tpd-filter-pixel-density = <0xc0>;
		tpd-filter-custom-prameters = <0x0 0x0 0x0 0x0 0x0 0x0 0x0 0x0 0x0 0x0 0x0 0x0>;
		tpd-filter-custom-speed = <0x0 0x0 0x0>;
		chipsemi,int-gpio = <&pio 0x9 0x0>;
		chipsemi,rst-gpio = <&pio 0x98 0x0>;
	};
};

&touch {
	tpd-resolution = <0x1e0 0x356>;
	use-tpd-button = <0x1>;
	tpd-key-num = <0x3>;
	tpd-key-local = <0x9e 0xac 0x244 0x0>;
	tpd-key-dim-local = <0x3c 0x38b 0x28 0x28 0x12c 0x38b 0x28 0x28 0xb4 0x38b 0x28 0x28 0x0 0x0 0x0 0x0>;
	tpd-max-touch-num = <0xa>;
	tpd-filter-enable = <0x0>;
	tpd-filter-pixel-density = <0xc0>;
	tpd-filter-custom-prameters = <0x0 0x0 0x0 0x0 0x0 0x0 0x0 0x0 0x0 0x0 0x0 0x0>;
	tpd-filter-custom-speed = <0x0 0x0 0x0>;
	gpio-en-std = <&pio 0x9e 0x0>;
	pinctrl-names = "default", "state_eint_as_int", "state_eint_output0", "state_eint_output1", "state_rst_output0", "state_rst_output1";
	pinctrl-0 = <&ctp_pins_default>;
	pinctrl-1 = <&ctp_pins_eint_as_int>;
	pinctrl-2 = <&ctp_pins_eint_output0>;
	pinctrl-3 = <&ctp_pins_eint_output1>;
	pinctrl-4 = <&ctp_pins_rst_output0>;
	pinctrl-5 = <&ctp_pins_rst_output1>;
	status = "okay";
};

&pio {

	ctp_pins_default: eint0default {
	};

	ctp_pins_eint_as_int: eint@0 {

		pins_cmd_dat {
			pinmux = <0x900>;
			slew-rate = <0x0>;
			bias-disable;
		};
	};

	ctp_pins_eint_output0: eintoutput0 {

		pins_cmd_dat {
			pinmux = <0x900>;
			slew-rate = <0x1>;
			output-low;
		};
	};

	ctp_pins_eint_output1: eintoutput1 {

		pins_cmd_dat {
			pinmux = <0x900>;
			slew-rate = <0x1>;
			output-high;
		};
	};

	ctp_pins_rst_output0: rstoutput0 {

		pins_cmd_dat {
			pinmux = <0x9800>;
			slew-rate = <0x1>;
			output-low;
		};
	};

	ctp_pins_rst_output1: rstoutput1 {

		pins_cmd_dat {
			pinmux = <0x9800>;
			slew-rate = <0x1>;
			output-high;
		};
	};
};

&spi0 {
	status = "okay";
	#address-cells = <0x1>;
	#size-cells = <0x0>;
	tee-only;

	fingerprint@0 {
		compatible = "mediatek,fingerprint";
		reg = <0x0>;
		pinctrl-names = "miso_pull_up", "miso_pull_disable", "miso_as_gpio", "miso_as_spi_mi", "mosi_as_spi_mo", "mosi_as_gpio", "finger_sd_low", "finger_sd_high", "finger_cs_as_spi_cs", "finger_cs_as_gpio", "finger_rst_low", "finger_rst_high", "finger_power_low", "finger_power_high", "eint_as_int", "finger_clk_as_spi_clk", "finger_clk_as_gpio", "default";
		pinctrl-0 = <&miso_pull_up>;
		pinctrl-1 = <&miso_pull_disable>;
		pinctrl-2 = <&miso_as_gpio>;
		pinctrl-3 = <&miso_as_spi_mi>;
		pinctrl-4 = <&mosi_as_spi_mo>;
		pinctrl-5 = <&mosi_as_gpio>;
		pinctrl-6 = <&finger_sd_low>;
		pinctrl-7 = <&finger_sd_high>;
		pinctrl-8 = <&finger_cs_as_spi_cs>;
		pinctrl-9 = <&finger_cs_as_gpio>;
		pinctrl-10 = <&finger_rst_low>;
		pinctrl-11 = <&finger_rst_high>;
		pinctrl-12 = <&finger_power_low>;
		pinctrl-13 = <&finger_power_high>;
		pinctrl-14 = <&finger_eint>;
		pinctrl-15 = <&finger_clk_as_spi_clk>;
		pinctrl-16 = <&finger_clk_as_gpio>;
		pinctrl-17 = <&finger_pins_default>;
		interrupt-parent = <&pio>;
		interrupts = <0x8 0x2>;
		debounce = <0x8 0x0>;
		gpio-irq = <0x8>;
		gpio-irq-std = <&pio 0x8 0x0>;
		gpio-sd-std = <&pio 0x6e 0x0>;
		status = "okay";
	};
};

&pio {

	miso_pull_up: miso_pull_up@gpio33 {

		pins_cmd_dat {
			pinmux = <0x2100>;
			slew-rate = <0x0>;
			bias-pull-up = <0xb>;
			output-low;
		};
	};

	miso_pull_disable: miso_pull_disable@gpio33 {

		pins_cmd_dat {
			pinmux = <0x2100>;
			slew-rate = <0x0>;
			bias-disable;
			output-low;
		};
	};

	miso_as_gpio: miso_as_gpio@gpio33 {

		pins_cmd_dat {
			pinmux = <0x2100>;
			slew-rate = <0x0>;
			bias-disable;
			output-low;
			input-schmitt-enable = <0x0>;
		};
	};

	miso_as_spi_mi: miso_as_spi_mi@gpio33 {

		pins_cmd_dat {
			pinmux = <0x2101>;
			slew-rate = <0x0>;
			bias-disable;
			output-low;
			input-schmitt-enable = <0x0>;
		};
	};

	mosi_as_spi_mo: mosi_as_spi_mo@gpio32 {

		pins_cmd_dat {
			pinmux = <0x2001>;
			slew-rate = <0x0>;
			bias-disable;
			output-low;
			input-schmitt-enable = <0x0>;
		};
	};

	mosi_as_gpio: mosi_as_gpio@gpio32 {

		pins_cmd_dat {
			pinmux = <0x2000>;
			slew-rate = <0x0>;
			bias-disable;
			output-low;
			input-schmitt-enable = <0x0>;
		};
	};

	finger_cs_as_spi_cs: finger_cs_as_spi_cs@gpio31 {

		pins_cmd_dat {
			pinmux = <0x1f01>;
			slew-rate = <0x1>;
			bias-disable;
			output-low;
			input-schmitt-enable = <0x0>;
		};
	};

	finger_cs_as_gpio: finger_cs_as_gpio@gpio31 {

		pins_cmd_dat {
			pinmux = <0x1f00>;
			slew-rate = <0x1>;
			bias-disable;
			output-low;
			input-schmitt-enable = <0x0>;
		};
	};

	finger_clk_as_spi_clk: finger_clk_as_spi_clk@gpio30 {

		pins_cmd_dat {
			pinmux = <0x1e01>;
			slew-rate = <0x1>;
			bias-disable;
			output-low;
			input-schmitt-enable = <0x0>;
		};
	};

	finger_clk_as_gpio: finger_clk_as_gpio@gpio30 {

		pins_cmd_dat {
			pinmux = <0x1e01>;
			slew-rate = <0x1>;
			bias-disable;
			output-low;
			input-schmitt-enable = <0x0>;
		};
	};

	finger_sd_low: finger_sd_low@gpio110 {

		pins_cmd_dat {
			pinmux = <0x6e00>;
			slew-rate = <0x1>;
			bias-disable;
			output-low;
		};
	};

	finger_sd_high: finger_sd_high@gpio110 {

		pins_cmd_dat {
			pinmux = <0x6e00>;
			slew-rate = <0x1>;
			bias-disable;
			output-high;
		};
	};

	finger_rst_low: finger_rst_low@gpio109 {

		pins_cmd_dat {
			pinmux = <0x6d00>;
			slew-rate = <0x1>;
			bias-disable;
			output-low;
		};
	};

	finger_rst_high: finger_rst_high@gpio109 {

		pins_cmd_dat {
			pinmux = <0x6d00>;
			slew-rate = <0x1>;
			bias-disable;
			output-high;
		};
	};

	finger_power_low: finger_power_low@gpio108 {

		pins_cmd_dat {
			pinmux = <0x6c00>;
			slew-rate = <0x1>;
			bias-disable;
			output-low;
		};
	};

	finger_power_high: finger_power_high@gpio108 {

		pins_cmd_dat {
			pinmux = <0x6c00>;
			slew-rate = <0x1>;
			bias-disable;
			output-high;
		};
	};

	finger_eint: finger_eint@gpio8 {

		pins_cmd_dat {
			pinmux = <0x800>;
			slew-rate = <0x0>;
			bias-pull-up = <0x0>;
		};
	};

	finger_pins_default: fp_pins_default {
	};
};

&i2c6 {

	speaker_amp: speaker_amp@34 {
		compatible = "mediatek,speaker_amp";
		#sound-dai-cells = <0x0>;
		reg = <0x34>;
		fwm-name = "frsm-spk1.bin";
		sdz-gpios = <&pio 0x3a 0x0>;
		spkr-id = <0x1>;
		ref-rdc = <0x67fd>;
		status = "okay";
	};
};

&sound {
	mediatek,spk-i2s = <0x3 0x0>;

	mediatek,speaker-codec {
		sound-dai = <&speaker_amp>;
	};
};

&frsm_amp {
	compatible = "foursemi,frsm-amp";
	frsm,amp-ndev = <0x1>;
	frsm,misc-enable;
	frsm,class-enable;
	status = "okay";
};

&mmc1 {
	cd-gpios = <&pio 0x7 0x0>;
	vmmc-supply = <&mt6358_vmch_eint_low>;
};

&i2c6 {

	coulomb_mtk: coulomb@2f {
		compatible = "mediatek,coulomb";
		reg = <0x2f>;
		status = "okay";
	};
};

&irtx_pwm {
	pwm_ch = <0x0>;
};

&i2c7 {
	#address-cells = <0x1>;
	#size-cells = <0x0>;
	clock-frequency = <0x61a80>;

	aw2033: aw2033@45 {
		compatible = "awinic,aw2033_led";
		reg = <0x45>;
		status = "okay";
		aw2033,INT-gpio = <&pio 0x6 0x0>;

		aw2033,red {
			aw2033,name = "red";
			aw2033,id = <0x0>;
			aw2033,imax = <0x1>;
			aw2033,led-current = <0x3>;
			aw2033,max-brightness = <0xff>;
			aw2033,rise-time-ms = <0x6>;
			aw2033,hold-time-ms = <0x0>;
			aw2033,fall-time-ms = <0x6>;
			aw2033,off-time-ms = <0x4>;
		};

		aw2033,green {
			aw2033,name = "green";
			aw2033,id = <0x1>;
			aw2033,imax = <0x1>;
			aw2033,led-current = <0x3>;
			aw2033,max-brightness = <0xff>;
			aw2033,rise-time-ms = <0x6>;
			aw2033,hold-time-ms = <0x0>;
			aw2033,fall-time-ms = <0x6>;
			aw2033,off-time-ms = <0x4>;
		};

		aw2033,blue {
			aw2033,name = "blue";
			aw2033,id = <0x2>;
			aw2033,imax = <0x1>;
			aw2033,led-current = <0x3>;
			aw2033,max-brightness = <0xff>;
			aw2033,rise-time-ms = <0x6>;
			aw2033,hold-time-ms = <0x0>;
			aw2033,fall-time-ms = <0x6>;
			aw2033,off-time-ms = <0x4>;
		};
	};
};

&bp_thl {
	soc-limit-threshold = <0x0>;
};

&gpio_usage_mapping {
	GPIO_SIM1_HOT_PLUG = <&pio 0x17 0x0>;
	GPIO_SIM2_HOT_PLUG = <&pio 0x18 0x0>;
	GPIO_SIM1_SCLK = <&pio 0x4d 0x0>;
	GPIO_SIM1_SRST = <&pio 0x4e 0x0>;
	GPIO_SIM1_SIO = <&pio 0x4f 0x0>;
	GPIO_SIM2_SCLK = <&pio 0x50 0x0>;
	GPIO_SIM2_SRST = <&pio 0x51 0x0>;
	GPIO_SIM2_SIO = <&pio 0x52 0x0>;
	GPIO_FDD_BAND_SUPPORT_DETECT_1ST_PIN = <&pio 0x6f 0x0>;
};

&gpio {
	gpio_init_default = <0x0 0x0 0x0 0x0 0x1 0x1 0x1 0x1 0x0 0x0 0x0 0x1 0x1 0x1 0x2 0x0 0x0 0x0 0x1 0x0 0x1 0x3 0x0 0x1 0x0 0x1 0x0 0x1 0x4 0x0 0x0 0x0 0x1 0x1 0x1 0x5 0x0 0x1 0x0 0x1 0x0 0x1 0x6 0x0 0x0 0x0 0x1 0x0 0x1 0x7 0x0 0x0 0x0 0x1 0x1 0x1 0x8 0x0 0x0 0x0 0x1 0x0 0x1 0x9 0x0 0x0 0x0 0x1 0x1 0x1 0xa 0x0 0x1 0x1 0x1 0x0 0x1 0xb 0x0 0x0 0x0 0x1 0x1 0x1 0xc 0x0 0x1 0x1 0x1 0x0 0x1 0xd 0x0 0x0 0x0 0x1 0x1 0x1 0xe 0x0 0x0 0x0 0x1 0x0 0x0 0xf 0x0 0x1 0x0 0x1 0x0 0x0 0x10 0x0 0x1 0x0 0x1 0x0 0x0 0x11 0x0 0x0 0x0 0x1 0x0 0x0 0x12 0x0 0x1 0x0 0x1 0x0 0x0 0x13 0x0 0x1 0x0 0x1 0x0 0x0 0x14 0x0 0x1 0x0 0x1 0x0 0x0 0x15 0x0 0x1 0x0 0x1 0x0 0x0 0x16 0x0 0x1 0x0 0x1 0x0 0x0 0x17 0x1 0x0 0x0 0x1 0x1 0x0 0x18 0x1 0x0 0x0 0x1 0x1 0x0 0x19 0x2 0x0 0x0 0x1 0x0 0x1 0x1a 0x0 0x1 0x0 0x1 0x0 0x1 0x1b 0x0 0x1 0x0 0x1 0x0 0x1 0x1c 0x1 0x0 0x0 0x1 0x1 0x1 0x1d 0x1 0x0 0x0 0x0 0x0 0x1 0x1e 0x1 0x0 0x0 0x0 0x0 0x1 0x1f 0x1 0x0 0x0 0x0 0x0 0x1 0x20 0x1 0x0 0x0 0x0 0x0 0x1 0x21 0x1 0x0 0x0 0x1 0x0 0x1 0x22 0x0 0x1 0x0 0x1 0x0 0x0 0x23 0x0 0x1 0x0 0x1 0x0 0x0 0x24 0x0 0x1 0x0 0x1 0x0 0x0 0x25 0x0 0x1 0x0 0x1 0x0 0x0 0x26 0x2 0x0 0x0 0x0 0x0 0x1 0x27 0x2 0x0 0x0 0x0 0x0 0x1 0x28 0x2 0x0 0x0 0x0 0x0 0x1 0x29 0x2 0x0 0x0 0x1 0x0 0x1 0x2a 0x0 0x0 0x0 0x1 0x1 0x0 0x2b 0x0 0x1 0x0 0x1 0x0 0x0 0x2c 0x0 0x1 0x1 0x1 0x0 0x0 0x2d 0x0 0x1 0x1 0x1 0x0 0x0 0x2e 0x1 0x0 0x0 0x0 0x0 0x1 0x2f 0x0 0x1 0x0 0x1 0x0 0x1 0x30 0x1 0x0 0x0 0x0 0x0 0x1 0x31 0x1 0x0 0x0 0x1 0x0 0x1 0x32 0x2 0x0 0x0 0x0 0x0 0x1 0x33 0x2 0x0 0x0 0x0 0x0 0x1 0x34 0x2 0x0 0x0 0x0 0x0 0x1 0x35 0x2 0x0 0x0 0x1 0x0 0x1 0x36 0x0 0x1 0x0 0x1 0x0 0x1 0x37 0x0 0x1 0x0 0x1 0x0 0x1 0x38 0x0 0x0 0x0 0x1 0x0 0x1 0x39 0x0 0x1 0x0 0x1 0x0 0x1 0x3a 0x0 0x1 0x0 0x1 0x0 0x1 0x3b 0x0 0x1 0x0 0x1 0x0 0x1 0x3c 0x0 0x1 0x0 0x1 0x0 0x1 0x3d 0x0 0x1 0x0 0x1 0x0 0x1 0x3e 0x0 0x1 0x0 0x1 0x0 0x1 0x3f 0x0 0x1 0x0 0x1 0x0 0x1 0x40 0x0 0x1 0x0 0x1 0x0 0x1 0x41 0x0 0x1 0x1 0x1 0x0 0x1 0x42 0x1 0x0 0x0 0x1 0x1 0x0 0x43 0x1 0x0 0x0 0x1 0x1 0x1 0x44 0x5 0x0 0x0 0x1 0x0 0x1 0x45 0x0 0x0 0x0 0x1 0x0 0x1 0x46 0x0 0x0 0x0 0x1 0x0 0x1 0x47 0x0 0x1 0x0 0x1 0x0 0x1 0x48 0x0 0x1 0x0 0x1 0x0 0x1 0x49 0x0 0x1 0x0 0x1 0x0 0x1 0x4a 0x0 0x1 0x0 0x1 0x0 0x1 0x4b 0x0 0x1 0x1 0x1 0x0 0x1 0x4c 0x0 0x1 0x1 0x1 0x0 0x1 0x4d 0x1 0x0 0x0 0x0 0x0 0x1 0x4e 0x1 0x0 0x0 0x0 0x0 0x1 0x4f 0x1 0x0 0x0 0x1 0x1 0x1 0x50 0x1 0x0 0x0 0x0 0x0 0x1 0x51 0x1 0x0 0x0 0x0 0x0 0x1 0x52 0x1 0x0 0x0 0x1 0x1 0x1 0x53 0x1 0x0 0x0 0x1 0x0 0x1 0x54 0x1 0x0 0x0 0x0 0x0 0x1 0x55 0x1 0x0 0x0 0x0 0x0 0x1 0x56 0x3 0x0 0x0 0x1 0x1 0x0 0x57 0x1 0x0 0x0 0x1 0x0 0x0 0x58 0x1 0x0 0x0 0x1 0x0 0x0 0x59 0x1 0x0 0x0 0x1 0x0 0x0 0x5a 0x1 0x0 0x0 0x1 0x0 0x0 0x5b 0x1 0x0 0x0 0x1 0x0 0x0 0x5c 0x1 0x0 0x0 0x1 0x0 0x0 0x5d 0x1 0x0 0x0 0x1 0x0 0x0 0x5e 0x1 0x0 0x0 0x1 0x0 0x0 0x5f 0x3 0x0 0x0 0x1 0x0 0x0 0x60 0x1 0x0 0x0 0x1 0x0 0x0 0x61 0x1 0x0 0x0 0x1 0x0 0x0 0x62 0x1 0x0 0x0 0x1 0x0 0x0 0x63 0x0 0x0 0x0 0x0 0x0 0x0 0x64 0x0 0x0 0x0 0x1 0x0 0x0 0x65 0x0 0x0 0x0 0x1 0x0 0x0 0x66 0x0 0x0 0x0 0x1 0x0 0x0 0x67 0x0 0x1 0x0 0x1 0x0 0x0 0x68 0x0 0x1 0x0 0x1 0x0 0x0 0x69 0x0 0x0 0x0 0x1 0x0 0x0 0x6a 0x0 0x1 0x0 0x1 0x0 0x0 0x6b 0x0 0x1 0x0 0x1 0x0 0x0 0x6c 0x0 0x1 0x1 0x1 0x0 0x0 0x6d 0x0 0x1 0x0 0x1 0x0 0x0 0x6e 0x0 0x0 0x0 0x1 0x0 0x0 0x6f 0x0 0x0 0x0 0x0 0x0 0x0 0x70 0x1 0x0 0x0 0x0 0x0 0x0 0x71 0x1 0x0 0x0 0x1 0x0 0x0 0x72 0x1 0x0 0x0 0x0 0x0 0x0 0x73 0x1 0x0 0x0 0x1 0x0 0x0 0x74 0x0 0x1 0x0 0x1 0x0 0x0 0x75 0x0 0x1 0x0 0x1 0x0 0x0 0x76 0x0 0x1 0x0 0x1 0x0 0x0 0x77 0x1 0x0 0x0 0x1 0x0 0x0 0x78 0x0 0x1 0x0 0x1 0x0 0x0 0x79 0x1 0x0 0x0 0x1 0x0 0x0 0x7a 0x1 0x0 0x0 0x0 0x0 0x0 0x7b 0x1 0x0 0x0 0x0 0x0 0x0 0x7c 0x1 0x0 0x0 0x1 0x0 0x0 0x7d 0x1 0x0 0x0 0x1 0x0 0x0 0x7e 0x1 0x0 0x0 0x1 0x0 0x0 0x7f 0x0 0x0 0x0 0x1 0x0 0x0 0x80 0x1 0x0 0x0 0x1 0x0 0x0 0x81 0x1 0x0 0x0 0x1 0x0 0x0 0x82 0x1 0x0 0x0 0x1 0x1 0x1 0x83 0x1 0x0 0x0 0x1 0x1 0x1 0x84 0x2 0x0 0x0 0x1 0x1 0x0 0x85 0x2 0x0 0x0 0x1 0x1 0x0 0x86 0x1 0x0 0x0 0x1 0x1 0x1 0x87 0x1 0x0 0x0 0x1 0x1 0x1 0x88 0x1 0x0 0x0 0x1 0x1 0x1 0x89 0x1 0x0 0x0 0x1 0x1 0x1 0x8a 0x1 0x0 0x0 0x1 0x1 0x1 0x8b 0x1 0x0 0x0 0x1 0x1 0x1 0x8c 0x1 0x0 0x0 0x1 0x1 0x1 0x8d 0x1 0x0 0x0 0x1 0x1 0x1 0x8e 0x1 0x0 0x0 0x1 0x1 0x1 0x8f 0x1 0x0 0x0 0x1 0x1 0x1 0x90 0x1 0x0 0x0 0x1 0x1 0x1 0x91 0x1 0x0 0x0 0x1 0x1 0x1 0x92 0x1 0x0 0x0 0x1 0x1 0x1 0x93 0x1 0x0 0x0 0x1 0x1 0x1 0x94 0x2 0x0 0x0 0x1 0x1 0x1 0x95 0x2 0x0 0x0 0x1 0x1 0x1 0x96 0x0 0x1 0x0 0x1 0x0 0x1 0x97 0x0 0x1 0x1 0x1 0x0 0x1 0x98 0x0 0x1 0x0 0x1 0x0 0x1 0x99 0x0 0x1 0x1 0x1 0x0 0x1 0x9a 0x0 0x1 0x0 0x1 0x0 0x1 0x9b 0x0 0x1 0x0 0x1 0x0 0x1 0x9c 0x0 0x1 0x0 0x1 0x0 0x1 0x9d 0x0 0x1 0x0 0x1 0x0 0x1 0x9e 0x2 0x0 0x0 0x1 0x0 0x0 0x9f 0x2 0x0 0x0 0x1 0x0 0x0 0xa0 0x1 0x0 0x0 0x0 0x0 0x1 0xa1 0x1 0x0 0x0 0x0 0x0 0x1 0xa2 0x1 0x0 0x0 0x0 0x0 0x1 0xa3 0x1 0x0 0x0 0x1 0x0 0x1 0xa4 0x1 0x0 0x0 0x0 0x0 0x1 0xa5 0x1 0x0 0x0 0x0 0x0 0x1 0xa6 0x1 0x0 0x0 0x0 0x0 0x1 0xa7 0x1 0x0 0x0 0x1 0x0 0x1 0xa8 0x1 0x0 0x0 0x0 0x0 0x0 0xa9 0x1 0x0 0x0 0x0 0x0 0x1 0xaa 0x1 0x0 0x0 0x0 0x0 0x1 0xab 0x1 0x0 0x0 0x0 0x0 0x1 0xac 0x1 0x0 0x0 0x0 0x0 0x1 0xad 0x1 0x0 0x0 0x1 0x0 0x1 0xae 0x1 0x0 0x0 0x1 0x0 0x1 0xaf 0x1 0x0 0x0 0x1 0x0 0x1 0xb0 0x1 0x0 0x0 0x1 0x0 0x1 0xb1 0x1 0x0 0x0 0x1 0x0 0x0 0xb2 0x1 0x0 0x0 0x1 0x0 0x0 0xb3 0x1 0x0 0x0 0x1 0x0 0x0 0xb4 0x1 0x0 0x0 0x1 0x0 0x0 0xb5 0x1 0x0 0x0 0x1 0x0 0x0 0xb6 0x1 0x0 0x0 0x1 0x0 0x0 0xb7 0x1 0x0 0x0 0x1 0x0 0x0 0xb8 0x1 0x0 0x0 0x1 0x0 0x0 0xb9 0x1 0x0 0x0 0x1 0x0 0x0 0xba 0x0 0x0 0x0 0x1 0x0 0x1 0xbb 0x0 0x0 0x0 0x1 0x0 0x1 0xbc 0x0 0x0 0x0 0x1 0x0 0x0 0xbd 0x0 0x0 0x0 0x1 0x0 0x0 0xbe 0x0 0x0 0x0 0x1 0x0 0x0 0xbf 0x0 0x0 0x0 0x1 0x0 0x0 0xc0 0x0 0x0 0x0 0x1 0x0 0x0 0xc1 0x0 0x0 0x0 0x1 0x0 0x0 0xc2 0x0 0x0 0x0 0x1 0x0 0x0 0xc3 0x0 0x0 0x0 0x1 0x0 0x0 0xc4 0x0 0x0 0x0 0x1 0x0 0x0 0xc5 0x0 0x0 0x0 0x1 0x0 0x0 0xc6 0x0 0x0 0x0 0x1 0x0 0x0 0xc7 0x0 0x0 0x0 0x1 0x0 0x0 0xc8 0x0 0x0 0x0 0x1 0x0 0x0 0xc9 0x0 0x0 0x0 0x1 0x0 0x0 0xca 0x0 0x0 0x0 0x1 0x0 0x0 0xcb 0x0 0x0 0x0 0x1 0x0 0x0 0xcc 0x0 0x0 0x0 0x1 0x0 0x0 0xcd 0x0 0x0 0x0 0x1 0x0 0x0 0xce 0x0 0x0 0x0 0x1 0x0 0x0 0xcf 0x0 0x0 0x0 0x1 0x0 0x0 0xd0 0x0 0x0 0x0 0x1 0x0 0x0 0xd1 0x0 0x0 0x0 0x1 0x0 0x0 0xd2 0x0 0x0 0x0 0x1 0x0 0x0 0xd3 0x0 0x0 0x0 0x1 0x0 0x0 0xd4 0x0 0x0 0x0 0x1 0x0 0x0 0xd5 0x0 0x0 0x0 0x1 0x0 0x0 0xd6 0x0 0x0 0x0 0x1 0x0 0x0 0xd7 0x0 0x0 0x0 0x1 0x0 0x0 0xd8 0x0 0x0 0x0 0x1 0x0 0x0 0xd9 0x0 0x0 0x0 0x1 0x0 0x0 0xda 0x0 0x0 0x0 0x1 0x0 0x0 0xdb 0x0 0x0 0x0 0x1 0x0 0x0 0xdc 0x0 0x0 0x0 0x1 0x0 0x0 0xdd 0x0 0x0 0x0 0x1 0x0 0x0>;
};

&goodix_fp {
	interrupt-parent = <&pio>;
	interrupts = <0x8 0x8>;
	status = "okay";
};

&touch {
	interrupt-parent = <&pio>;
	interrupts = <0x9 0x2>;
	status = "okay";
};

&dsi_te {
	interrupt-parent = <&pio>;
	interrupts = <0x53 0x1>;
	status = "okay";
};

&md1_sim1_hot_plug_eint {
	compatible = "mediatek,md1_sim1_hot_plug_eint-eint";
	interrupts = <0x0 0x8>;
	debounce = <0x0 0x2710>;
	dedicated = <0x0 0x0>;
	src_pin = <0x0 0x1>;
	sockettype = <0x0 0x0>;
	status = "okay";
};

&md1_sim2_hot_plug_eint {
	compatible = "mediatek,md1_sim2_hot_plug_eint-eint";
	interrupts = <0x1 0x8>;
	debounce = <0x1 0x2710>;
	dedicated = <0x1 0x0>;
	src_pin = <0x1 0x2>;
	sockettype = <0x1 0x0>;
	status = "okay";
};

&keypad {
	mediatek,key-debounce = <0x400>;
	mediatek,sw-pwrkey = <0x74>;
	mediatek,hw-pwrkey = <0x8>;
	mediatek,sw-rstkey = <0x66>;
	mediatek,hw-rstkey = <0x11>;
	mediatek,use-extend-type = <0x0>;
	mediatek,hw-map-num = <0x48>;
	mediatek,hw-init-map = <0x73 0x72 0xf9 0x0 0x0 0x0 0x0 0x0 0x0 0x0 0x0 0x0 0x0 0x0 0x0 0x0 0x0 0x0 0x0 0x0 0x0 0x0 0x0 0x0 0x0 0x0 0x0 0x0 0x0 0x0 0x0 0x0 0x0 0x0 0x0 0x0 0x0 0x0 0x0 0x0 0x0 0x0 0x0 0x0 0x0 0x0 0x0 0x0 0x0 0x0 0x0 0x0 0x0 0x0 0x0 0x0 0x0 0x0 0x0 0x0 0x0 0x0 0x0 0x0 0x0 0x0 0x0 0x0 0x0 0x0 0x0 0x0>;
	mediatek,pwrkey-eint-gpio = <0x0>;
	mediatek,pwkey-gpio-din = <0x0>;
	mediatek,hw-dl-key0 = <0x0>;
	mediatek,hw-dl-key1 = <0x1>;
	mediatek,hw-dl-key2 = <0x8>;
	mediatek,hw-recovery-key = <0x0>;
	status = "okay";
};
